## kiwibelay/main/Kconfig.projbuild
```kconfig
menu "Hackathon board demo"

    config HACK_DISPLAY_ROTATE_180
        bool "Rotate display by 180 degrees"
        default n
        help
            Enable if the text on the OLED appears upside down.

endmenu
```
